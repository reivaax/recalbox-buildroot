## package/openal/Config.in
```kconfig
config BR2_PACKAGE_OPENAL
        bool "openal"
	help
          openal project.
	  https://github.com/JogAmp/openal-soft
```

## package/physfs/Config.in
```kconfig
config BR2_PACKAGE_PHYSFS
        bool "physfs"
	help
          physfs project.	
	  http://icculus.org/pipermail/physfs/2012-October/001056.html	  
```

## package/sdl2_ttf/Config.in
```kconfig
config BR2_PACKAGE_SDL2_TTF
	bool "sdl2_TTF"
	depends on BR2_PACKAGE_SDL2
	select BR2_PACKAGE_FREETYPE
	help
	  SDL_ttf is a sample TrueType font library. It allows you to
	  use TrueType fonts in your SDL applications.

	  http://www.libsdl.org/projects/SDL_ttf/
```

## package/zeldasolarusdx/Config.in
```kconfig
config BR2_PACKAGE_ZELDASOLARUSDX
        bool "zeldasolarusdx"
	depends on BR2_INSTALL_LIBSTDCPP
	depends on BR2_PACKAGE_LIBPTHREAD_STUBS
	depends on BR2_PACKAGE_SDL2
	depends on BR2_PACKAGE_VORBIS_TOOLS
	depends on BR2_PACKAGE_MODPLUGTOOLS
	depends on BR2_PACKAGE_LUA_5_1
        select BR2_PACKAGE_OPENAL 
	select BR2_PACKAGE_PHYSFS
	select BR2_PACKAGE_SDL2_IMAGE
	select BR2_PACKAGE_SDL2_TTF
        help
          Zelda-like 2D game engine.
	  https://github.com/christopho/solarus/

comment "Zelda Solarus needs a toolchain w/ C++, LUA, Openal, vorbistools , modplugtools, physfs and SDL2"
	depends on !BR2_INSTALL_LIBSTDCPP || !BR2_PACKAGE_LIBPTHREAD_STUBS || \
		!BR2_PACKAGE_SDL2 || !BR2_PACKAGE_VORBIS_TOOLS || \
		!BR2_PACKAGE_MODPLUGTOOLS || !BR2_PACKAGE_LUA_5_1 
		
	
```
